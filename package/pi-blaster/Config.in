## package/pi-blaster/Config.in
```kconfig
config BR2_PACKAGE_PI_BLASTER
    bool "pi-blaster"
    depends on BR2_LINUX_KERNEL_DEFCONFIG = "bcm2709"
    help
        This project enables PWM on the GPIO pins you request
        of a Raspberry Pi. The technique used is extremely 
        efficient: does not use the CPU and gives very stable pulses.

        https://github.com/sarfata/pi-blaster
```

## package/wlan/Config.in
```kconfig
config BR2_PACKAGE_WLAN
    bool "wlan"
    help
        Enable wlan config

if BR2_PACKAGE_WLAN
config BR2_PACKAGE_WLAN_INDEX
    int "Wlan interface index number"
    default 0
    help
        Value of the wireless lan interface index number

config BR2_PACKAGE_WLAN_IP
    string "Wlan interface ip address"
    default 192.168.69.1
    help
        Value of the wireless lan interface static ip

config BR2_PACKAGE_WLAN_MASK
    string "Wlan interface network mask"
    default 255.255.255.0
    help
        Value of the wireless lan interface network mask

endif
```
